## components/kdefs/Kconfig
```kconfig
# Switches for the whole board: what the firmware is, and its power states.
# Every layer may read them, so they live in the lowest one.

menu "Kode Dot"

    choice KODEOS_BOOT_ROLE
        prompt "What this firmware is"
        default KODEOS_BOOT_ROLE_APP
        help
            Decides whether AO_Boot may write otadata. The default is an app,
            which never does, so a firmware that does not say what it is
            cannot keep the board.

        config KODEOS_BOOT_ROLE_APP
            bool "A user app, running from the apps region"
            help
                AO_Boot never writes otadata. A reset returns to kodeOS, even
                a crash on the first line, unless the app was installed
                through the mailbox: that one starts again.

        config KODEOS_BOOT_ROLE_OS
            bool "kodeOS itself, running from factory"
            select KODEOS_APPMGR
            help
                AO_Boot clears otadata at startup so the next boot is kodeOS,
                reports why the board booted, hands the board over to the app
                slot and runs the factory reset. Selects KODEOS_APPMGR.
    endchoice

    config KODEOS_WELCOME_APP
        string "The app the first boot after a factory reset runs, by project name"
        depends on KODEOS_BOOT_ROLE_OS
        default "welcome"
        help
            The project name of the app the first boot after a factory reset
            installs and runs. The factory reset keeps this app and refuses to
            run without it. The default is a placeholder: the firmware's own
            defaults set the real name.

    config KODEOS_HOME_HOLD
        bool "Holding BOT for 600 ms returns to kodeOS"
        default y
        depends on KODEOS_BOOT_ROLE_APP
        help
            Holding the bottom button reboots into kodeOS, even from a hung
            app. An app that must save first calls kode_sys_home_defer() from
            its HOME_SIG handler, then kode_sys_home_now() when it is done.
            AO_Boot waits KODE_SYS_HOME_GRACE_MS for the deferral and
            KODE_SYS_HOME_DEFER_MAX_MS at most, then reboots anyway.

            If unsure, say Y.

    config KODE_LOWPOWER
        bool "AO_LowPower: the AWAKE, ASLEEP and OFF states"
        default n
        depends on KODEOS_RADIO
        select PM_ENABLE
        select FREERTOS_USE_TICKLESS_IDLE
        select PM_LIGHT_SLEEP_CALLBACKS
        help
            Three states for the whole board. AWAKE: everything runs. ASLEEP:
            light sleep whenever every task is idle, woken by the buttons, the
            expander or the C5. OFF: deep sleep with the C5, the card and the
            radios in reset, woken by the expander. A USB cable keeps the
            board AWAKE. Off, nothing sleeps.

            If unsure, say N.

    config KODE_LOWPOWER_IDLE
        bool "AO_LowPower counts the idle time (sleep_after)"
        default y
        depends on KODE_LOWPOWER
        help
            AO_LowPower goes ASLEEP after `sleep_after` with no input. Turn it
            off when the app's interface decides when the board rests, as
            kodeOS does; the `sleep_after` setting is then not offered.

            If unsure, say Y.

endmenu
```

## components/khal/Kconfig
```kconfig
menu "khal: console ports"

    config KHAL_CONSOLE_DOCK
        bool "Console also on the magnetic dock (USB CDC on GPIO26/27)"
        depends on IDF_TARGET_ESP32P4
        help
            A second console on the magnetic pads, as USB CDC through the
            charging base. It takes the OTG controller, which an app may want
            for itself. kodeOS raises CONFIG_TINYUSB_CDC_RX_BUFSIZE and
            _TX_BUFSIZE to 4096 so a whole 4 KB install window fits, which
            costs about 7 KB of internal RAM.

            If unsure, say N.

    config KHAL_CONSOLE_DOCK_TX_WAIT_MS
        int "Longest a console write waits for the dock host to drain"
        depends on KHAL_CONSOLE_DOCK
        range 0 200
        default 20
        help
            How long a write waits for the dock's host to read before it drops
            the rest, so a port nobody reads never slows the console.

endmenu
```

## components/klog/Kconfig
```kconfig
# klog's compile-time ceiling and its starting level at run time.

menu "klog"

    choice KLOG_MAXIMUM_LEVEL_CHOICE
        prompt "Most verbose klog level compiled in"
        default KLOG_MAXIMUM_LEVEL_DEBUG
        help
            KLOG_x lines below this level are not compiled in: no flash, and
            `log_level` cannot turn them back on. kodeOS keeps NOTICE or more,
            because the factory reads the boot banner, a NOTICE line.

        config KLOG_MAXIMUM_LEVEL_DEBUG
            bool "Debug: everything"
        config KLOG_MAXIMUM_LEVEL_INFO
            bool "Info"
        config KLOG_MAXIMUM_LEVEL_NOTICE
            bool "Notice: outcomes, answers and the system's state"
        config KLOG_MAXIMUM_LEVEL_WARN
            bool "Warning"
        config KLOG_MAXIMUM_LEVEL_ERROR
            bool "Error"
        config KLOG_MAXIMUM_LEVEL_NONE
            bool "None: no klog line at all"
    endchoice

    # kode_log_lvl_t: DEBUG 0, INFO 1, NOTICE 2, WARN 3, ERROR 4, OFF 5.
    config KLOG_MAXIMUM_LEVEL
        int
        default 0 if KLOG_MAXIMUM_LEVEL_DEBUG
        default 1 if KLOG_MAXIMUM_LEVEL_INFO
        default 2 if KLOG_MAXIMUM_LEVEL_NOTICE
        default 3 if KLOG_MAXIMUM_LEVEL_WARN
        default 4 if KLOG_MAXIMUM_LEVEL_ERROR
        default 5 if KLOG_MAXIMUM_LEVEL_NONE

    choice KLOG_DEFAULT_LEVEL_CHOICE
        prompt "Level the console starts at"
        default KLOG_DEFAULT_LEVEL_INFO
        help
            The global level until `log_level tag="*"` stores another one on
            the board. It cannot be more verbose than the ceiling above.

        config KLOG_DEFAULT_LEVEL_DEBUG
            bool "Debug"
            depends on KLOG_MAXIMUM_LEVEL_DEBUG
        config KLOG_DEFAULT_LEVEL_INFO
            bool "Info"
            depends on KLOG_MAXIMUM_LEVEL < 2
        config KLOG_DEFAULT_LEVEL_NOTICE
            bool "Notice"
            depends on KLOG_MAXIMUM_LEVEL < 3
        config KLOG_DEFAULT_LEVEL_WARN
            bool "Warning"
            depends on KLOG_MAXIMUM_LEVEL < 4
        config KLOG_DEFAULT_LEVEL_ERROR
            bool "Error"
            depends on KLOG_MAXIMUM_LEVEL < 5
        config KLOG_DEFAULT_LEVEL_OFF
            bool "Off: answers only"
    endchoice

    config KLOG_DEFAULT_LEVEL
        int
        default 0 if KLOG_DEFAULT_LEVEL_DEBUG
        default 1 if KLOG_DEFAULT_LEVEL_INFO
        default 2 if KLOG_DEFAULT_LEVEL_NOTICE
        default 3 if KLOG_DEFAULT_LEVEL_WARN
        default 4 if KLOG_DEFAULT_LEVEL_ERROR
        default 5 if KLOG_DEFAULT_LEVEL_OFF

endmenu
```

## components/kqp/Kconfig
```kconfig
menu "kqp"

    config KQP_AO_WATCH
        bool "Watch every Active Object for a stuck or starved step"
        default y
        help
            Panics with a core dump naming any Active Object that stays inside
            one event, or holds events and dispatches none, for 30 s. A step
            longer than KQP_AO_STEP_MAX_MS is logged as a warning. Initial
            transitions are not watched. Needs the task watchdog
            (CONFIG_ESP_TASK_WDT_EN).

            If unsure, say Y.

    config KQP_AO_STEP_MAX_MS
        int "Longest step an Active Object may take, in ms"
        depends on KQP_AO_WATCH
        range 100 10000
        default 5000
        help
            A step longer than this is logged as a warning, with its length. The
            time includes waiting for a core, so a low-priority Active Object
            can pass a second while others run.

endmenu
```

## components/kscreen/Kconfig
```kconfig
# kscreen's choices for an app that draws.

menu "kscreen"

    config KSCREEN_ROTATE_PAD
        bool "The pad turns with the glass"
        default y
        help
            When an app turns its glass with kscreen_set_rotation(), the four
            pad buttons publish the direction they point on the turned glass:
            at 270 degrees, the pad's right reads as up. TOP and BOT are side
            buttons and never turn. Off, the app gets the buttons as wired
            whatever the glass shows, and maps them itself.

endmenu
```
